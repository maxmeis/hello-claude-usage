## main/Kconfig.projbuild
```kconfig
menu "OAuth probe"
    config HELLO_BOX_USB_TEST_HELPER
        bool "Temporary USB setup test helper (development only)"
        default n
        help
            Enables an explicit USB console command to read the temporary
            setup AP and page details for local hardware tests. Keep disabled
            in normal firmware and restore normal firmware after testing.

    config OAUTH_PROBE_HTTP_PORT
        int "Local settings and Wi-Fi setup HTTP port"
        range 1024 65535
        default 8080
        help
            The random, short-lived account settings and Wi-Fi setup URLs use
            this port. Their servers run separately during normal operation
            and temporary Wi-Fi provisioning.
endmenu

menu "Display diagnostics"
    config CLAUDE_DISPLAY_DIAGNOSTIC
        bool "Run raw RGB565 display test instead of the monitor"
        default n
        help
            Temporary hardware test. Bypasses LVGL, Wi-Fi and OAuth, and does
            not read or change saved credentials. Flash the normal firmware
            again to return to the monitor.
endmenu
```

## sdkconfig.defaults
```kconfig
CONFIG_IDF_TARGET="esp32s3"
CONFIG_ESP_DEFAULT_CPU_FREQ_MHZ_240=y
CONFIG_ESPTOOLPY_FLASHMODE_QIO=y
CONFIG_ESPTOOLPY_FLASHFREQ_80M=y
CONFIG_ESPTOOLPY_FLASHSIZE_8MB=y
CONFIG_SPIRAM=y
CONFIG_SPIRAM_MODE_OCT=y
CONFIG_SPIRAM_SPEED_80M=y
CONFIG_SPIRAM_FETCH_INSTRUCTIONS=y
CONFIG_SPIRAM_RODATA=y
CONFIG_SPIRAM_USE_MALLOC=y
CONFIG_PARTITION_TABLE_CUSTOM=y
CONFIG_PARTITION_TABLE_CUSTOM_FILENAME="partitions.csv"
CONFIG_FREERTOS_HZ=1000
CONFIG_COMPILER_OPTIMIZATION_PERF=y
CONFIG_LCD_BOARD_SENSECAP_INDICATOR_D1=y
CONFIG_SENSECAP_INDICATOR_SCREEN_GX=y
CONFIG_LCD_EVB_SCREEN_FREQ=16
CONFIG_LCD_AVOID_TEAR=y
CONFIG_LCD_LVGL_DIRECT_MODE=y
CONFIG_LCD_TASK_REFRESH_TIME=20
CONFIG_LV_MEM_CUSTOM=y
CONFIG_LV_FONT_MONTSERRAT_22=y
CONFIG_LV_FONT_MONTSERRAT_24=y
CONFIG_LV_FONT_MONTSERRAT_36=y
CONFIG_LV_FONT_MONTSERRAT_48=y
CONFIG_LV_USE_QRCODE=y
CONFIG_MBEDTLS_CERTIFICATE_BUNDLE=y
CONFIG_MBEDTLS_CERTIFICATE_BUNDLE_DEFAULT_FULL=y
CONFIG_ESP_MAIN_TASK_STACK_SIZE=8192
CONFIG_HTTPD_MAX_REQ_HDR_LEN=2048
CONFIG_LOG_DEFAULT_LEVEL_INFO=y
CONFIG_ESP_CONSOLE_UART_DEFAULT=y

# Advertise only the default Wi-Fi STA/AP interfaces; browsing is unused.
CONFIG_MDNS_PREDEF_NETIF_STA=y
CONFIG_MDNS_PREDEF_NETIF_AP=y
CONFIG_MDNS_ENABLE_BROWSE=n
```
